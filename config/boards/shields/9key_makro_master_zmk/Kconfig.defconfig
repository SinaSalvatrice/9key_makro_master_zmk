## config/boards/shields/9key_makro_master_zmk/Kconfig.defconfig
```kconfig
if SHIELD_9KEY_MAKRO_MASTER_ZMK

config ZMK_KEYBOARD_NAME
    default "9key LED Test"

config ZMK_RGB_UNDERGLOW
    default y

endif
```

## config/boards/shields/nice_nano_4x6/Kconfig.defconfig
```kconfig
if SHIELD_SILENT_DISPLAY_3X3

config ZMK_KEYBOARD_NAME
    default "Silent 3x3"

endif
```
