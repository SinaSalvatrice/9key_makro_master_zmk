#include <dt-bindings/zmk/matrix_transform.h>

/ {
    chosen {
        zmk,kscan = &kscan0;
        zmk,matrix-transform = &default_transform;
    };

    /*
     * LED-only safety overlay:
     * - no physical matrix GPIOs
     * - no encoder GPIOs
     * - no OLED/I2C display
     *
     * ZMK still expects a kscan + transform for a keyboard shield, so this
     * uses a 1x1 mock scanner that generates no events. The single keymap
     * position is bound to &none in the keymap file.
     */
    default_transform: keymap_transform_0 {
        compatible = "zmk,matrix-transform";
        columns = <1>;
        rows = <1>;
        map = <RC(0,0)>;
    };

    kscan0: kscan {
        compatible = "zmk,kscan-mock";
        rows = <1>;
        columns = <1>;
        events = <>;
    };
};
